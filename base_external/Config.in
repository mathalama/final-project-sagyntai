## base_external/Config.in
```kconfig
source "$BR2_EXTERNAL_PROJECT_BASE_PATH/package/security-driver/Config.in"
source "$BR2_EXTERNAL_PROJECT_BASE_PATH/package/security-app/Config.in"
```

## base_external/package/security-app/Config.in
```kconfig
config BR2_PACKAGE_SECURITY_APP
	bool "security-app"
	help
	  User-space application for the Security Sensor system.
	  Monitors the security sensor driver and reports alerts.
```

## base_external/package/security-driver/Config.in
```kconfig
config BR2_PACKAGE_SECURITY_DRIVER
	bool "security-driver"
	depends on BR2_LINUX_KERNEL
	help
	  Custom security sensor driver for Final Project.
```
